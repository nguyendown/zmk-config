## config/boards/arm/blackpill_f401cc/Kconfig.board
```kconfig
# Copyright (c) 2022 The ZMK Contributors
# SPDX-License-Identifier: MIT

config BOARD_BLACKPILL_F401CC
	bool "BlackPill F401CC"
	depends on SOC_STM32F401XC
```

## config/boards/arm/blackpill_f401cc/Kconfig.defconfig
```kconfig
# Copyright (c) 2022 The ZMK Contributors
# SPDX-License-Identifier: MIT

if BOARD_BLACKPILL_F401CC

config BOARD
	default "blackpill_f401cc"

config ZMK_USB
	default y

if BUILD_OUTPUT_UF2

config BUILD_OUTPUT_UF2_USE_FLASH_BASE
    default y

config BUILD_OUTPUT_UF2_USE_FLASH_OFFSET
    default y

endif # BUILD_OUTPUT_UF2

endif # BOARD_BLACKPILL_F401CC
```

## config/boards/arm/blackpill_f401cc/blackpill_f401cc_defconfig
```kconfig
# SPDX-License-Identifier: MIT

CONFIG_SOC_SERIES_STM32F4X=y
CONFIG_SOC_STM32F401XC=y
# 84MHz system clock
CONFIG_SYS_CLOCK_HW_CYCLES_PER_SEC=84000000

# enable pinctrl
CONFIG_PINCTRL=y

# enable GPIO
CONFIG_GPIO=y

# clock configuration
CONFIG_CLOCK_CONTROL=y

CONFIG_USE_DT_CODE_PARTITION=y
CONFIG_BUILD_OUTPUT_UF2=y
```

## config/boards/shields/cresk/Kconfig.shield
```kconfig
# Copyright (c) 2022 The ZMK Contributors
# SPDX-License-Identifier: MIT

config SHIELD_CRESK
    def_bool $(shields_list_contains,cresk)
```

## config/boards/shields/cresk_100/Kconfig.defconfig
```kconfig
# Copyright (c) 2022 The ZMK Contributors
# SPDX-License-Identifier: MIT

if SHIELD_CRESK_100 || SHIELD_CRESK_V2

config ZMK_KEYBOARD_NAME
	default "cresk_100"

config ZMK_USB
	default y

if ZMK_DISPLAY

config I2C
	default y

config SSD1306
	default y

config SSD1306_REVERSE_MODE
	default y

endif # ZMK_DISPLAY

if LVGL

config LV_Z_VDB_SIZE
	default 100

config LV_Z_DPI
	default 148

config LV_Z_BITS_PER_PIXEL
	default 1

choice LV_COLOR_DEPTH
	default LV_COLOR_DEPTH_1
endchoice

endif # LVGL

if BUILD_OUTPUT_UF2

config BUILD_OUTPUT_UF2_USE_FLASH_BASE
	default y

config BUILD_OUTPUT_UF2_USE_FLASH_OFFSET
	default y

endif # BUILD_OUTPUT_UF2

endif # SHIELD_CRESK_100 || SHIELD_CRESK_V2
```

## config/boards/shields/cresk_100/Kconfig.shield
```kconfig
# Copyright (c) 2022 The ZMK Contributors
# SPDX-License-Identifier: MIT

config SHIELD_CRESK_100
	def_bool $(shields_list_contains,cresk_100)
```

## config/boards/shields/cresk_choc/Kconfig.defconfig
```kconfig
# Copyright (c) 2022 The ZMK Contributors
# SPDX-License-Identifier: MIT

if SHIELD_CRESK_CHOC_LEFT

config ZMK_KEYBOARD_NAME
    default "cresk_choc"

config ZMK_SPLIT_ROLE_CENTRAL
    default y

endif # SHIELD_CRESK_CHOC_LEFT

if SHIELD_CRESK_CHOC_LEFT || SHIELD_CRESK_CHOC_RIGHT

config ZMK_SPLIT
    default y

endif # SHIELD_CRESK_CHOC_LEFT || SHIELD_CRESK_CHOC_RIGHT
```

## config/boards/shields/cresk_choc/Kconfig.shield
```kconfig
# Copyright (c) 2022 The ZMK Contributors
# SPDX-License-Identifier: MIT

config SHIELD_CRESK_CHOC_LEFT
    def_bool $(shields_list_contains,cresk_choc_left)

config SHIELD_CRESK_CHOC_RIGHT
    def_bool $(shields_list_contains,cresk_choc_right)
```

## config/boards/shields/cresk_v2/Kconfig.shield
```kconfig
# Copyright (c) 2022 The ZMK Contributors
# SPDX-License-Identifier: MIT

config SHIELD_CRESK_V2
    def_bool $(shields_list_contains,cresk_v2)
```

## config/west.yml
```yaml
manifest:
  remotes:
    - name: zmkfirmware
      url-base: https://github.com/zmkfirmware
    - name: nguyendown
      url-base: https://github.com/nguyendown
    - name: petejohanson
      url-base: https://github.com/petejohanson
  projects:
    - name: zmk
      remote: petejohanson
      revision: zephyr/3.1-upgrade
      import: app/west.yml
  self:
    path: config
```
